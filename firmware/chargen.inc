charg1	; 9x5
				; space
	db	b'00000000',b'00000000'
	db	b'00000000',b'00000000'
	db	b'00000000',b'00000000'
	db	b'00000000',b'00000000'
	db	b'00000000'
				; !
	db	b'00010000',b'00010000'
	db	b'00010000',b'00010000'
	db	b'00010000',b'00000000'
	db	b'00010000',b'00000000'
	db	b'00000000'
				; "
	db	b'00101000',b'00101000'
	db	b'00000000',b'00000000'
	db	b'00000000',b'00000000'
	db	b'00000000',b'00000000'
	db	b'00000000'
				; #
	db	b'00101000',b'00101000'
	db	b'01111100',b'00101000'
	db	b'01111100',b'00101000'
	db	b'00101000',b'00000000'
	db	b'00000000'
				; $
	db	b'00010000',b'00111100'
	db	b'01010000',b'00111000'
	db	b'00010100',b'01111000'
	db	b'00010000',b'00000000'
	db	b'00000000'
				; %
	db	b'01100000',b'01100100'
	db	b'00001000',b'00010000'
	db	b'00100000',b'01001100'
	db	b'00001100',b'00000000'
	db	b'00000000'
				; &
	db	b'00100000',b'01010000'
	db	b'00100000',b'01010000'
	db	b'01001100',b'01001000'
	db	b'00110100',b'00000000'
	db	b'00000000'
				; '
	db	b'00010000',b'00010000'
	db	b'00000000',b'00000000'
	db	b'00000000',b'00000000'
	db	b'00000000',b'00000000'
	db	b'00000000'
				; (
	db	b'00001000',b'00010000'
	db	b'00100000',b'00100000'
	db	b'00100000',b'00010000'
	db	b'00001000',b'00000000'
	db	b'00000000'
				; )
	db	b'00100000',b'00010000'
	db	b'00001000',b'00001000'
	db	b'00001000',b'00010000'
	db	b'00100000',b'00000000'
	db	b'00000000'
				; *
	db	b'00000000',b'00101000'
	db	b'00010000',b'01111100'
	db	b'00010000',b'00101000'
	db	b'00000000',b'00000000'
	db	b'00000000'
				; +
	db	b'00000000',b'00010000'
	db	b'00010000',b'01111100'
	db	b'00010000',b'00010000'
	db	b'00000000',b'00000000'
	db	b'00000000'
				; ,
	db	b'00000000',b'00000000'
	db	b'00000000',b'00000000'
	db	b'00000000',b'00000000'
	db	b'00010000',b'00100000'
	db	b'00000000'
				; -
	db	b'00000000',b'00000000'
	db	b'00000000',b'01111100'
	db	b'00000000',b'00000000'
	db	b'00000000',b'00000000'
	db	b'00000000'
				; .
	db	b'00000000',b'00000000'
	db	b'00000000',b'00000000'
	db	b'00000000',b'00000000'
	db	b'00100000',b'00000000'
	db	b'00000000'
				; /
	db	b'00000000',b'00000100'
	db	b'00001000',b'00010000'
	db	b'00100000',b'01000000'
	db	b'00000000',b'00000000'
	db	b'00000000'
				; 0
	db	b'00111000',b'01000100'
	db	b'01000100',b'01000100'
	db	b'01000100',b'01000100'
	db	b'00111000',b'00000000'
	db	b'00000000'
				; 1
	db	b'00010000',b'00110000'
	db	b'00010000',b'00010000'
	db	b'00010000',b'00010000'
	db	b'00111000',b'00000000'
	db	b'00000000'
				; 2
	db	b'00111000',b'01000100'
	db	b'00000100',b'00001000'
	db	b'00010000',b'00100000'
	db	b'01111100',b'00000000'
	db	b'00000000'
				; 3
	db	b'00111000',b'01000100'
	db	b'00000100',b'00011000'
	db	b'00000100',b'01000100'
	db	b'00111000',b'00000000'
	db	b'00000000'
				; 4
	db	b'00000100',b'00001100'
	db	b'00010100',b'00100100'
	db	b'01111100',b'00000100'
	db	b'00000100',b'00000000'
	db	b'00000000'
				; 5
	db	b'01111100',b'01000000'
	db	b'01000000',b'01111000'
	db	b'00000100',b'00000100'
	db	b'01111000',b'00000000'
	db	b'00000000'
				; 6
	db	b'00111000',b'01000100'
	db	b'01000000',b'01111000'
	db	b'01000100',b'01000100'
	db	b'00111000',b'00000000'
	db	b'00000000'
				; 7
	db	b'01111100',b'00000100'
	db	b'00001000',b'00010000'
	db	b'00100000',b'00100000'
	db	b'00100000',b'00000000'
	db	b'00000000'
				; 8
	db	b'00111000',b'01000100'
	db	b'01000100',b'00111000'
	db	b'01000100',b'01000100'
	db	b'00111000',b'00000000'
	db	b'00000000'
				; 9
	db	b'00111000',b'01000100'
	db	b'01000100',b'00111100'
	db	b'00000100',b'00000100'
	db	b'00111000',b'00000000'
	db	b'00000000'
				; :
	db	b'00000000',b'00100000'
	db	b'00000000',b'00000000'
	db	b'00000000',b'00100000'
	db	b'00000000',b'00000000'
	db	b'00000000'
				; ;
	db	b'00000000',b'00100000'
	db	b'00000000',b'00000000'
	db	b'00000000',b'00100000'
	db	b'01000000',b'00000000'
	db	b'00000000'
				; <
	db	b'00001000',b'00010000'
	db	b'00100000',b'01000000'
	db	b'00100000',b'00010000'
	db	b'00001000',b'00000000'
	db	b'00000000'
				; =
	db	b'00000000',b'00000000'
	db	b'01111100',b'00000000'
	db	b'01111100',b'00000000'
	db	b'00000000',b'00000000'
	db	b'00000000'
				; >
	db	b'00100000',b'00010000'
	db	b'00001000',b'00000100'
	db	b'00001000',b'00010000'
	db	b'00100000',b'00000000'
	db	b'00000000'
				; ?
	db	b'00111000',b'01000100'
	db	b'00000100',b'00001000'
	db	b'00010000',b'00000000'
	db	b'00010000',b'00000000'
	db	b'00000000'


				; @
	db	b'00111000',b'01000100'
	db	b'01001100',b'01010100'
	db	b'01001100',b'01000000'
	db	b'00111100',b'00000000'
	db	b'00000000'
				; A
	db	b'00010000',b'00101000'
	db	b'01000100',b'01000100'
	db	b'01111100',b'01000100'
	db	b'01000100',b'00000000'
	db	b'00000000'
				; B
	db	b'01111000',b'01000100'
	db	b'01000100',b'01111000'
	db	b'01000100',b'01000100'
	db	b'01111000',b'00000000'
	db	b'00000000'
				; C
	db	b'00111000',b'01000100'
	db	b'01000000',b'01000000'
	db	b'01000000',b'01000100'
	db	b'00111000',b'00000000'
	db	b'00000000'
				; D
	db	b'01110000',b'01001000'
	db	b'01000100',b'01000100'
	db	b'01000100',b'01001000'
	db	b'01110000',b'00000000'
	db	b'00000000'
				; E
	db	b'01111100',b'01000000'
	db	b'01000000',b'01111000'
	db	b'01000000',b'01000000'
	db	b'01111100',b'00000000'
	db	b'00000000'
				; F
	db	b'01111100',b'01000000'
	db	b'01000000',b'01111000'
	db	b'01000000',b'01000000'
	db	b'01000000',b'00000000'
	db	b'00000000'
				; G
	db	b'00111000',b'01000100'
	db	b'01000000',b'01011100'
	db	b'01000100',b'01000100'
	db	b'00111000',b'00000000'
	db	b'00000000'
				; H
	db	b'01000100',b'01000100'
	db	b'01000100',b'01111100'
	db	b'01000100',b'01000100'
	db	b'01000100',b'00000000'
	db	b'00000000'
				; I
	db	b'00111000',b'00010000'
	db	b'00010000',b'00010000'
	db	b'00010000',b'00010000'
	db	b'00111000',b'00000000'
	db	b'00000000'
				; J
	db	b'00000100',b'00000100'
	db	b'00000100',b'00000100'
	db	b'00000100',b'01000100'
	db	b'00111000',b'00000000'
	db	b'00000000'
				; K
	db	b'01000100',b'01001000'
	db	b'01010000',b'01100000'
	db	b'01010000',b'01001000'
	db	b'01000100',b'00000000'
	db	b'00000000'
				; L
	db	b'01000000',b'01000000'
	db	b'01000000',b'01000000'
	db	b'01000000',b'01000000'
	db	b'01111100',b'00000000'
	db	b'00000000'
				; M
	db	b'01000100',b'01101100'
	db	b'01010100',b'01000100'
	db	b'01000100',b'01000100'
	db	b'01000100',b'00000000'
	db	b'00000000'
				; N
	db	b'01000100',b'01000100'
	db	b'01000100',b'01100100'
	db	b'01010100',b'01001100'
	db	b'01000100',b'00000000'
	db	b'00000000'
				; O
	db	b'00111000',b'01000100'
	db	b'01000100',b'01000100'
	db	b'01000100',b'01000100'
	db	b'00111000',b'00000000'
	db	b'00000000'
				; P
	db	b'01111000',b'01000100'
	db	b'01000100',b'01111000'
	db	b'01000000',b'01000000'
	db	b'01000000',b'00000000'
	db	b'00000000'
				; Q
	db	b'00111000',b'01000100'
	db	b'01000100',b'01000100'
	db	b'01010100',b'01001000'
	db	b'00110100',b'00000000'
	db	b'00000000'
				; R
	db	b'01111000',b'01000100'
	db	b'01000100',b'01111000'
	db	b'01010000',b'01001000'
	db	b'01000100',b'00000000'
	db	b'00000000'
				; S
	db	b'00111000',b'01000100'
	db	b'01000000',b'00111000'
	db	b'00000100',b'01000100'
	db	b'00111000',b'00000000'
	db	b'00000000'
				; T
	db	b'01111100',b'00010000'
	db	b'00010000',b'00010000'
	db	b'00010000',b'00010000'
	db	b'00010000',b'00000000'
	db	b'00000000'
				; U
	db	b'01000100',b'01000100'
	db	b'01000100',b'01000100'
	db	b'01000100',b'01000100'
	db	b'00111000',b'00000000'
	db	b'00000000'
				; V
	db	b'01000100',b'01000100'
	db	b'01000100',b'01000100'
	db	b'01000100',b'00101000'
	db	b'00010000',b'00000000'
	db	b'00000000'
				; W
	db	b'01000100',b'01000100'
	db	b'01000100',b'01000100'
	db	b'01010100',b'01101100'
	db	b'01000100',b'00000000'
	db	b'00000000'
				; X
	db	b'01000100',b'01000100'
	db	b'00101000',b'00010000'
	db	b'00101000',b'01000100'
	db	b'01000100',b'00000000'
	db	b'00000000'
				; Y
	db	b'01000100',b'01000100'
	db	b'00101000',b'00010000'
	db	b'00010000',b'00010000'
	db	b'00010000',b'00000000'
	db	b'00000000'
				; Z
	db	b'01111100',b'00000100'
	db	b'00001000',b'00010000'
	db	b'00100000',b'01000000'
	db	b'01111100',b'00000000'
	db	b'00000000'
				; [
	db	b'00011000',b'00010000'
	db	b'00010000',b'00010000'
	db	b'00010000',b'00010000'
	db	b'00011000',b'00000000'
	db	b'00000000'
				; \
	db	b'00000000',b'01000000'
	db	b'00100000',b'00010000'
	db	b'00001000',b'00000100'
	db	b'00000000',b'00000000'
	db	b'00000000'
				; ]
	db	b'00110000',b'00010000'
	db	b'00010000',b'00010000'
	db	b'00010000',b'00010000'
	db	b'00110000',b'00000000'
	db	b'00000000'
				; ^
	db	b'00010000',b'00101000'
	db	b'01000100',b'00000000'
	db	b'00000000',b'00000000'
	db	b'00000000',b'00000000'
	db	b'00000000'
				; _
	db	b'00000000',b'00000000'
	db	b'00000000',b'00000000'
	db	b'00000000',b'00000000'
	db	b'00000000',b'01111100'
	db	b'00000000'

				; `
	db	b'00100000',b'00010000'
	db	b'00000000',b'00000000'
	db	b'00000000',b'00000000'
	db	b'00000000',b'00000000'
	db	b'00000000'
				; a
	db	b'00000000',b'00000000'
	db	b'00111000',b'00000100'
	db	b'00111100',b'01000100'
	db	b'00111100',b'00000000'
	db	b'00000000'
				; b
	db	b'01000000',b'01000000'
	db	b'01000000',b'01111000'
	db	b'01000100',b'01000100'
	db	b'01111000',b'00000000'
	db	b'00000000'
				; c
	db	b'00000000',b'00000000'
	db	b'00111100',b'01000000'
	db	b'01000000',b'01000000'
	db	b'00111100',b'00000000'
	db	b'00000000'
				; d
	db	b'00000100',b'00000100'
	db	b'00000100',b'00111100'
	db	b'01000100',b'01000100'
	db	b'00111100',b'00000000'
	db	b'00000000'
				; e
	db	b'00000000',b'00000000'
	db	b'00111000',b'01000100'
	db	b'01111100',b'01000000'
	db	b'00111100',b'00000000'
	db	b'00000000'
				; f
	db	b'00011000',b'00100100'
	db	b'00100000',b'01110000'
	db	b'00100000',b'00100000'
	db	b'00100000',b'00000000'
	db	b'00000000'
				; g
	db	b'00000000',b'00000000'
	db	b'00110100',b'01001100'
	db	b'01000100',b'01000100'
	db	b'00111100',b'00000100'
	db	b'00111000'
				; h
	db	b'01000000',b'01000000'
	db	b'01111000',b'01000100'
	db	b'01000100',b'01000100'
	db	b'01000100',b'00000000'
	db	b'00000000'
				; i
	db	b'00010000',b'00000000'
	db	b'00110000',b'00010000'
	db	b'00010000',b'00010000'
	db	b'00111000',b'00000000'
	db	b'00000000'
				; j
	db	b'00010000',b'00000000'
	db	b'00110000',b'00010000'
	db	b'00010000',b'00010000'
	db	b'00010000',b'00010000'
	db	b'01100000'
				; k
	db	b'01000000',b'01000000'
	db	b'01000100',b'01001000'
	db	b'01110000',b'01001000'
	db	b'01000100',b'00000000'
	db	b'00000000'
				; l
	db	b'00110000',b'00010000'
	db	b'00010000',b'00010000'
	db	b'00010000',b'00010000'
	db	b'00111000',b'00000000'
	db	b'00000000'
				; m
	db	b'00000000',b'00000000'
	db	b'01101000',b'01010100'
	db	b'01010100',b'01010100'
	db	b'01010100',b'00000000'
	db	b'00000000'
				; n
	db	b'00000000',b'00000000'
	db	b'01011000',b'01100100'
	db	b'01000100',b'01000100'
	db	b'01000100',b'00000000'
	db	b'00000000'
				; o
	db	b'00000000',b'00000000'
	db	b'00111000',b'01000100'
	db	b'01000100',b'01000100'
	db	b'00111000',b'00000000'
	db	b'00000000'
				; p
	db	b'00000000',b'00000000'
	db	b'01111000',b'01000100'
	db	b'01000100',b'01000100'
	db	b'01111000',b'01000000'
	db	b'01000000'
				; q
	db	b'00000000',b'00000000'
	db	b'00111100',b'01000100'
	db	b'01000100',b'01000100'
	db	b'00111100',b'00000100'
	db	b'00000100'
				; r
	db	b'00000000',b'00000000'
	db	b'01011100',b'01100000'
	db	b'01000000',b'01000000'
	db	b'01000000',b'00000000'
	db	b'00000000'
				; s
	db	b'00000000',b'00000000'
	db	b'00111100',b'01000000'
	db	b'00111000',b'00000100'
	db	b'01111000',b'00000000'
	db	b'00000000'
				; t
	db	b'00100000',b'00100000'
	db	b'01110000',b'00100000'
	db	b'00100000',b'00100100'
	db	b'00011000',b'00000000'
	db	b'00000000'
				; u
	db	b'00000000',b'00000000'
	db	b'01000100',b'01000100'
	db	b'01000100',b'01000100'
	db	b'00111100',b'00000000'
	db	b'00000000'
				; v
	db	b'00000000',b'00000000'
	db	b'01000100',b'01000100'
	db	b'01000100',b'00101000'
	db	b'00010000',b'00000000'
	db	b'00000000'
				; w
	db	b'00000000',b'00000000'
	db	b'01000100',b'01000100'
	db	b'01010100',b'01101100'
	db	b'01000100',b'00000000'
	db	b'00000000'
				; x
	db	b'00000000',b'00000000'
	db	b'01000100',b'00101000'
	db	b'00010000',b'00101000'
	db	b'01000100',b'00000000'
	db	b'00000000'
				; y
	db	b'00000000',b'00000000'
	db	b'01000100',b'01000100'
	db	b'01000100',b'00111100'
	db	b'00000100',b'00000100'
	db	b'00111000'
				; z
	db	b'00000000',b'00000000'
	db	b'01111100',b'00001000'
	db	b'00010000',b'00100000'
	db	b'01111100',b'00000000'
	db	b'00000000'
				; {
	db	b'00001000',b'00010000'
	db	b'00010000',b'00100000'
	db	b'00010000',b'00010000'
	db	b'00001000',b'00000000'
	db	b'00000000'
				; |
	db	b'00010000',b'00010000'
	db	b'00010000',b'00010000'
	db	b'00010000',b'00010000'
	db	b'00010000',b'00000000'
	db	b'00000000'
				; }
	db	b'00100000',b'00010000'
	db	b'00010000',b'00001000'
	db	b'00010000',b'00010000'
	db	b'00100000',b'00000000'
	db	b'00000000'
				; ~
	db	b'00100000',b'01010100'
	db	b'00001000',b'00000000'
	db	b'00000000',b'00000000'
	db	b'00000000',b'00000000'
	db	b'00000000'
				; 
	db	b'01111100',b'01000100'
	db	b'01000100',b'01000100'
	db	b'01000100',b'01000100'
	db	b'01111100',b'00000000'
	db	b'00000000'

; ***************************************************************************************
; ***************************************************************************************
; ***************************************************************************************

charg2	; 8x5 rotated CCW
				; space
	db	b'00000000',b'00000000'
	db	b'00000000',b'00000000'
	db	b'00000000'
				; !
	db	b'00000000',b'00000000'
	db	b'11111010',b'00000000'
	db	b'00000000'
				; "
	db	b'00000000',b'11000000'
	db	b'00000000',b'11000000'
	db	b'00000000'
				; #
	db	b'00101000',b'11111110'
	db	b'00101000',b'11111110'
	db	b'00101000'
				; $
	db	b'01001000',b'01010100'
	db	b'11111110',b'01010010'
	db	b'00100010'
				; %
	db	b'01000110',b'00100110'
	db	b'00010000',b'11001000'
	db	b'11000100'
				; &
	db	b'00001010',b'00001100'
	db	b'01010010',b'10100010'
	db	b'01011100'
				; '
	db	b'00000000',b'00000000'
	db	b'00000000',b'11000000'
	db	b'00000000'
				; (
	db	b'00000000',b'10000010'
	db	b'01000100',b'00111000'
	db	b'00000000'
				; )
	db	b'00000000',b'00111000'
	db	b'01000100',b'10000010'
	db	b'00000000'
				; *
	db	b'00010000',b'01010100'
	db	b'00111000',b'01010100'
	db	b'00010000'
				; +
	db	b'00010000',b'00010000'
	db	b'01111100',b'00010000'
	db	b'00010000'
				; ,
	db	b'00000000',b'00000000'
	db	b'00000010',b'00000001'
	db	b'00000000'
				; -
	db	b'00010000',b'00010000'
	db	b'00010000',b'00010000'
	db	b'00010000'
				; .
	db	b'00000000',b'00000000'
	db	b'00000000',b'00000010'
	db	b'00000000'
				; /
	db	b'00000100',b'00001000'
	db	b'00010000',b'00100000'
	db	b'01000000'
				; 0
	db	b'01111100',b'10000010'
	db	b'10000010',b'10000010'
	db	b'01111100'
				; 1
	db	b'00000000',b'00000010'
	db	b'11111110',b'01000010'
	db	b'00000000'
				; 2
	db	b'01100010',b'10010010'
	db	b'10001010',b'10000110'
	db	b'01000010'
				; 3
	db	b'01101100',b'10010010'
	db	b'10010010',b'10000010'
	db	b'01000100'
				; 4
	db	b'11111110',b'01001000'
	db	b'00101000',b'00011000'
	db	b'00001000'
				; 5
	db	b'10001100',b'10010010'
	db	b'10010010',b'10010010'
	db	b'11110010'
				; 6
	db	b'00001100',b'10010010'
	db	b'10010010',b'10010010'
	db	b'01111100'
				; 7
	db	b'11000000',b'10100000'
	db	b'10010000',b'10001110'
	db	b'10000000'
				; 8
	db	b'01101100',b'10010010'
	db	b'10010010',b'10010010'
	db	b'01101100'
				; 9
	db	b'01111100',b'10010010'
	db	b'10010010',b'10010010'
	db	b'01100000'
				; :
	db	b'00000000',b'00000000'
	db	b'00000000',b'01000100'
	db	b'00000000'
				; ;
	db	b'00000000',b'00000000'
	db	b'00000000',b'01000100'
	db	b'00000010'
				; <
	db	b'00000000',b'10000010'
	db	b'01000100',b'00101000'
	db	b'00010000'
				; =
	db	b'00101000',b'00101000'
	db	b'00101000',b'00101000'
	db	b'00101000'
				; >
	db	b'00010000',b'00101000'
	db	b'01000100',b'10000010'
	db	b'00000000'
				; ?
	db	b'01100000',b'10010000'
	db	b'10001010',b'10000000'
	db	b'01000000'


				; @
	db	b'01111010',b'10101010'
	db	b'10010010',b'10000010'
	db	b'01111100'
				; A
	db	b'00111110',b'01001000'
	db	b'10001000',b'01001000'
	db	b'00111110'
				; B
	db	b'01101100',b'10010010'
	db	b'10010010',b'10010010'
	db	b'11111110'
				; C
	db	b'01000100',b'10000010'
	db	b'10000010',b'10000010'
	db	b'01111100'
				; D
	db	b'00111000',b'01000100'
	db	b'10000010',b'10000010'
	db	b'11111110'
				; E
	db	b'10000010',b'10010010'
	db	b'10010010',b'10010010'
	db	b'11111110'
				; F
	db	b'10000000',b'10010000'
	db	b'10010000',b'10010000'
	db	b'11111110'
				; G
	db	b'00011110',b'10010010'
	db	b'10010010',b'10000010'
	db	b'01111100'
				; H
	db	b'11111110',b'00010000'
	db	b'00010000',b'00010000'
	db	b'11111110'
				; I
	db	b'00000000',b'10000010'
	db	b'11111110',b'10000010'
	db	b'00000000'
				; J
	db	b'11111100',b'00000010'
	db	b'00000010',b'00000010'
	db	b'00000100'
				; K
	db	b'10000010',b'01000100'
	db	b'00101000',b'00010000'
	db	b'11111110'
				; L
	db	b'00000010',b'00000010'
	db	b'00000010',b'00000010'
	db	b'11111110'
				; M
	db	b'11111110',b'01000000'
	db	b'00100000',b'01000000'
	db	b'11111110'
				; N
	db	b'11111110',b'00000100'
	db	b'00001000',b'00010000'
	db	b'11111110'
				; O
	db	b'01111100',b'10000010'
	db	b'10000010',b'10000010'
	db	b'01111100'
				; P
	db	b'01100000',b'10010000'
	db	b'10010000',b'10010000'
	db	b'11111110'
				; Q
	db	b'01111010',b'10000100'
	db	b'10001010',b'10000010'
	db	b'01111100'
				; R
	db	b'01100010',b'10010100'
	db	b'10011000',b'10010000'
	db	b'11111110'
				; S
	db	b'01001100',b'10010010'
	db	b'10010010',b'10010010'
	db	b'01100100'
				; T
	db	b'10000000',b'10000000'
	db	b'11111110',b'10000000'
	db	b'10000000'
				; U
	db	b'11111100',b'00000010'
	db	b'00000010',b'00000010'
	db	b'11111100'
				; V
	db	b'11111000',b'00000100'
	db	b'00000010',b'00000100'
	db	b'11111000'
				; W
	db	b'11111110',b'00000100'
	db	b'00001000',b'00000100'
	db	b'11111110'
				; X
	db	b'11000110',b'00101000'
	db	b'00010000',b'00101000'
	db	b'11000110'
				; Y
	db	b'11000000',b'00100000'
	db	b'00011110',b'00100000'
	db	b'11000000'
				; Z
	db	b'11000010',b'10100010'
	db	b'10010010',b'10001010'
	db	b'10000110'
				; [
	db	b'00000000',b'10000010'
	db	b'11111110',b'00000000'
	db	b'00000000'
				; \
	db	b'00000100',b'00001000'
	db	b'00010000',b'00100000'
	db	b'01000000'
				; ]
	db	b'00000000',b'00000000'
	db	b'11111110',b'10000010'
	db	b'00000000'
				; ^
	db	b'00100000',b'01000000'
	db	b'10000000',b'01000000'
	db	b'00100000'
				; _
	db	b'00000001',b'00000001'
	db	b'00000001',b'00000001'
	db	b'00000001'


				; `
	db	b'00000000',b'00000000'
	db	b'01000000',b'10000000'
	db	b'00000000'
				; a
	db	b'00011110',b'00101010'
	db	b'00101010',b'00101010'
	db	b'00000100'
				; b
	db	b'00001100',b'00010010'
	db	b'00010010',b'00010010'
	db	b'11111110'
				; c
	db	b'00100010',b'00100010'
	db	b'00100010',b'00100010'
	db	b'00011100'
				; d
	db	b'11111110',b'00010010'
	db	b'00010010',b'00010010'
	db	b'00001100'
				; e
	db	b'00011000',b'00101010'
	db	b'00101010',b'00101010'
	db	b'00011100'
				; f
	db	b'01000000',b'10000000'
	db	b'10010000',b'01111110'
	db	b'00010000'
				; g
	db	b'00111110',b'00100101'
	db	b'00100101',b'00100101'
	db	b'00011000'
				; h
	db	b'00011110',b'00100000'
	db	b'00100000',b'00100000'
	db	b'11111110'
				; i
	db	b'00000000',b'00000010'
	db	b'10111110',b'00100010'
	db	b'00000000'
				; j
	db	b'00000000',b'00000000'
	db	b'10111110',b'00100001'
	db	b'00000001'
				; k
	db	b'00100010',b'00010100'
	db	b'00001000',b'00001000'
	db	b'11111110'
				; l
	db	b'00000000',b'00000010'
	db	b'11111110',b'10000010'
	db	b'00000000'
				; m
	db	b'00011110',b'00100000'
	db	b'00011110',b'00100000'
	db	b'00111110'
				; n
	db	b'00011110',b'00100000'
	db	b'00100000',b'00010000'
	db	b'00111110'
				; o
	db	b'00011100',b'00100010'
	db	b'00100010',b'00100010'
	db	b'00011100'
				; p
	db	b'00011000',b'00100100'
	db	b'00100100',b'00100100'
	db	b'00111111'
				; q
	db	b'00111111',b'00100100'
	db	b'00100100',b'00100100'
	db	b'00011000'
				; r
	db	b'00100000',b'00100000'
	db	b'00100000',b'00010000'
	db	b'00111110'
				; s
	db	b'00100100',b'00101010'
	db	b'00101010',b'00101010'
	db	b'00010010'
				; t
	db	b'00000100',b'00000010'
	db	b'00100010',b'11111100'
	db	b'00100000'
				; u
	db	b'00111110',b'00000010'
	db	b'00000010',b'00000010'
	db	b'00111100'
				; v
	db	b'00111000',b'00000100'
	db	b'00000010',b'00000100'
	db	b'00111000'
				; w
	db	b'00111110',b'00000100'
	db	b'00001000',b'00000100'
	db	b'00111110'
				; x
	db	b'00100010',b'00010100'
	db	b'00001000',b'00010100'
	db	b'00100010'
				; y
	db	b'00111110',b'00001001'
	db	b'00001001',b'00001001'
	db	b'00110000'
				; z
	db	b'00100010',b'00110010'
	db	b'00101010',b'00100110'
	db	b'00100010'
				; {
	db	b'00000000',b'10000010'
	db	b'01101100',b'00010000'
	db	b'00000000'
				; |
	db	b'00000000',b'00000000'
	db	b'11111111',b'00000000'
	db	b'00000000'
				; }
	db	b'00000000',b'00010000'
	db	b'01101100',b'10000010'
	db	b'00000000'
				; ~
	db	b'01000000',b'00100000'
	db	b'01000000',b'10000000'
	db	b'01000000'
				; 
	db	b'11111110',b'10000010'
	db	b'10000010',b'10000010'
	db	b'11111110'

;***************************************************************************************
;***************************************************************************************
;***************************************************************************************

charg3	; 14x8
				; space
	db	b'00000000',b'00000000'
	db	b'00000000',b'00000000'
	db	b'00000000',b'00000000'
	db	b'00000000',b'00000000'
	db	b'00000000',b'00000000'
	db	b'00000000',b'00000000'
	db	b'00000000',b'00000000'
				; !
	db	b'00011000',b'00011000'
	db	b'00011000',b'00011000'
	db	b'00011000',b'00011000'
	db	b'00011000',b'00011000'
	db	b'00000000',b'00000000'
	db	b'00011000',b'00011000'
	db	b'00000000',b'00000000'
				; "
	db	b'01100110',b'01100110'
	db	b'01000100',b'00000000'
	db	b'00000000',b'00000000'
	db	b'00000000',b'00000000'
	db	b'00000000',b'00000000'
	db	b'00000000',b'00000000'
	db	b'00000000',b'00000000'
				; #
	db	b'01100110',b'01100110'
	db	b'01100110',b'11111111'
	db	b'11111111',b'01100110'
	db	b'01100110',b'11111111'
	db	b'11111111',b'01100110'
	db	b'01100110',b'01100110'
	db	b'00000000',b'00000000'
				; $
	db	b'00011000',b'00111110'
	db	b'01111110',b'11011000'
	db	b'11011000',b'01111100'
	db	b'00111110',b'00011011'
	db	b'00011011',b'01111110'
	db	b'01111100',b'00011000'
	db	b'00000000',b'00000000'
				; %
	db	b'11000000',b'11000001'
	db	b'00000011',b'00000110'
	db	b'00001100',b'00011000'
	db	b'00110000',b'01100000'
	db	b'11000000',b'10000000'
	db	b'00000011',b'00000011'
	db	b'00000000',b'00000000'
				; &
	db	b'00111100',b'01111110'
	db	b'01100110',b'01101100'
	db	b'00111000',b'00111000'
	db	b'01101100',b'11000111'
	db	b'11000111',b'11000111'
	db	b'01111110',b'00111001'
	db	b'00000000',b'00000000'
				; '
	db	b'00011000',b'00011000'
	db	b'00110000',b'00000000'
	db	b'00000000',b'00000000'
	db	b'00000000',b'00000000'
	db	b'00000000',b'00000000'
	db	b'00000000',b'00000000'
	db	b'00000000',b'00000000'
				; (
	db	b'00001100',b'00011000'
	db	b'00110000',b'01100000'
	db	b'01100000',b'01100000'
	db	b'01100000',b'01100000'
	db	b'01100000',b'00110000'
	db	b'00011000',b'00001100'
	db	b'00000000',b'00000000'
				; )
	db	b'00110000',b'00011000'
	db	b'00001100',b'00000110'
	db	b'00000110',b'00000110'
	db	b'00000110',b'00000110'
	db	b'00000110',b'00001100'
	db	b'00011000',b'00110000'
	db	b'00000000',b'00000000'
				; *
	db	b'10000001',b'11000011'
	db	b'01100110',b'00111100'
	db	b'00011000',b'11111111'
	db	b'11111111',b'00011000'
	db	b'00111100',b'01100110'
	db	b'11000011',b'10000001'
	db	b'00000000',b'00000000'
				; +
	db	b'00000000',b'00000000'
	db	b'00011000',b'00011000'
	db	b'00011000',b'11111111'
	db	b'11111111',b'00011000'
	db	b'00011000',b'00011000'
	db	b'00000000',b'00000000'
	db	b'00000000',b'00000000'
				; ,
	db	b'00000000',b'00000000'
	db	b'00000000',b'00000000'
	db	b'00000000',b'00000000'
	db	b'00000000',b'00000000'
	db	b'00000000',b'00000000'
	db	b'00110000',b'00110000'
	db	b'01100000',b'00000000'
				; -
	db	b'00000000',b'00000000'
	db	b'00000000',b'00000000'
	db	b'00000000',b'11111111'
	db	b'11111111',b'00000000'
	db	b'00000000',b'00000000'
	db	b'00000000',b'00000000'
	db	b'00000000',b'00000000'
				; .
	db	b'00000000',b'00000000'
	db	b'00000000',b'00000000'
	db	b'00000000',b'00000000'
	db	b'00000000',b'00000000'
	db	b'00000000',b'00000000'
	db	b'01100000',b'01100000'
	db	b'00000000',b'00000000'
				; /
	db	b'00000000',b'00000000'
	db	b'00000001',b'00000011'
	db	b'00000110',b'00001100'
	db	b'00011000',b'00110000'
	db	b'01100000',b'11000000'
	db	b'10000000',b'00000000'
	db	b'00000000',b'00000000'
				; 0
	db	b'00111100',b'01111110'
	db	b'11000011',b'11000011'
	db	b'11000011',b'11000011'
	db	b'11000011',b'11000011'
	db	b'11000011',b'11000011'
	db	b'01111110',b'00111100'
	db	b'00000000',b'00000000'
				; 1
	db	b'00011000',b'00111000'
	db	b'01111000',b'00011000'
	db	b'00011000',b'00011000'
	db	b'00011000',b'00011000'
	db	b'00011000',b'00011000'
	db	b'01111110',b'01111110'
	db	b'00000000',b'00000000'
				; 2
	db	b'00111100',b'01111110'
	db	b'11000011',b'00000011'
	db	b'00000110',b'00001100'
	db	b'00011000',b'00110000'
	db	b'01100000',b'11000000'
	db	b'11111111',b'11111111'
	db	b'00000000',b'00000000'
				; 3
	db	b'00111100',b'01111110'
	db	b'11000011',b'00000011'
	db	b'00000011',b'00001110'
	db	b'00001110',b'00000011'
	db	b'00000011',b'11000011'
	db	b'01111110',b'00111100'
	db	b'00000000',b'00000000'
				; 4
	db	b'00000110',b'00001110'
	db	b'00011110',b'00110110'
	db	b'01100110',b'11000110'
	db	b'11000110',b'11111111'
	db	b'11111111',b'00000110'
	db	b'00000110',b'00000110'
	db	b'00000000',b'00000000'
				; 5
	db	b'11111111',b'11111111'
	db	b'11000000',b'11000000'
	db	b'11000000',b'11111100'
	db	b'11111110',b'00000011'
	db	b'00000011',b'00000011'
	db	b'11111110',b'11111100'
	db	b'00000000',b'00000000'
				; 6
	db	b'00111110',b'01111110'
	db	b'11000000',b'11000000'
	db	b'11000000',b'11111100'
	db	b'11111110',b'11000011'
	db	b'11000011',b'11000011'
	db	b'01000110',b'00111100'
	db	b'00000000',b'00000000'
				; 7
	db	b'11111111',b'11111111'
	db	b'00000011',b'00000011'
	db	b'00000011',b'00000110'
	db	b'00001100',b'00011000'
	db	b'00110000',b'00110000'
	db	b'00110000',b'00110000'
	db	b'00000000',b'00000000'
				; 8
	db	b'00111100',b'01111110'
	db	b'11000011',b'11000011'
	db	b'11000011',b'01111110'
	db	b'01111110',b'11000011'
	db	b'11000011',b'11000011'
	db	b'01111110',b'00111100'
	db	b'00000000',b'00000000'
				; 9
	db	b'00111100',b'01111110'
	db	b'11000011',b'11000011'
	db	b'11000011',b'01111111'
	db	b'00111111',b'00000011'
	db	b'00000011',b'00000011'
	db	b'01111110',b'01111100'
	db	b'00000000',b'00000000'
				; :
	db	b'00000000',b'00011000'
	db	b'00011000',b'00000000'
	db	b'00000000',b'00000000'
	db	b'00000000',b'00000000'
	db	b'00000000',b'00011000'
	db	b'00011000',b'00000000'
	db	b'00000000',b'00000000'
				; ;
	db	b'00000000',b'00011000'
	db	b'00011000',b'00000000'
	db	b'00000000',b'00000000'
	db	b'00000000',b'00000000'
	db	b'00000000',b'00000000'
	db	b'00011000',b'00011000'
	db	b'00010000',b'00000000'
				; <
	db	b'00000011',b'00000110'
	db	b'00001100',b'00011000'
	db	b'00110000',b'01100000'
	db	b'01100000',b'00110000'
	db	b'00011000',b'00001100'
	db	b'00000110',b'00000011'
	db	b'00000000',b'00000000'
				; =
	db	b'00000000',b'00000000'
	db	b'00000000',b'11111111'
	db	b'11111111',b'00000000'
	db	b'00000000',b'11111111'
	db	b'11111111',b'00000000'
	db	b'00000000',b'00000000'
	db	b'00000000',b'00000000'
				; >
	db	b'11000000',b'01100000'
	db	b'00110000',b'00011000'
	db	b'00001100',b'00000110'
	db	b'00000110',b'00001100'
	db	b'00011000',b'00110000'
	db	b'01100000',b'11000000'
	db	b'00000000',b'00000000'
				; ?
	db	b'00111100',b'01111110'
	db	b'11000011',b'00000011'
	db	b'00000110',b'00001100'
	db	b'00011000',b'00011000'
	db	b'00011000',b'00000000'
	db	b'00011000',b'00011000'
	db	b'00000000',b'00000000'

				; @
	db	b'00111100',b'01111110'
	db	b'11000011',b'11000011'
	db	b'11011011',b'11011110'
	db	b'11011100',b'11000000'
	db	b'11000000',b'11000000'
	db	b'01111110',b'00111110'
	db	b'00000000',b'00000000'
				; A
	db	b'00011000',b'00111100'
	db	b'01100110',b'11000011'
	db	b'11000011',b'11000011'
	db	b'11000011',b'11111111'
	db	b'11111111',b'11000011'
	db	b'11000011',b'11000011'
	db	b'00000000',b'00000000'
				; B
	db	b'11111100',b'11111110'
	db	b'11000011',b'11000011'
	db	b'11000011',b'11111110'
	db	b'11111110',b'11000011'
	db	b'11000011',b'11000011'
	db	b'11111110',b'11111100'
	db	b'00000000',b'00000000'
				; C
	db	b'00111100',b'01111111'
	db	b'11000011',b'11000000'
	db	b'11000000',b'11000000'
	db	b'11000000',b'11000000'
	db	b'11000000',b'11000011'
	db	b'01111110',b'00111100'
	db	b'00000000',b'00000000'
				; D
	db	b'11111100',b'11111110'
	db	b'11000011',b'11000011'
	db	b'11000011',b'11000011'
	db	b'11000011',b'11000011'
	db	b'11000011',b'11000011'
	db	b'11111110',b'11111100'
	db	b'00000000',b'00000000'
				; E
	db	b'11111111',b'11111111'
	db	b'11000000',b'11000000'
	db	b'11000000',b'11111110'
	db	b'11111110',b'11000000'
	db	b'11000000',b'11000000'
	db	b'11111111',b'11111111'
	db	b'00000000',b'00000000'
				; F
	db	b'11111111',b'11111111'
	db	b'11000000',b'11000000'
	db	b'11000000',b'11111110'
	db	b'11111110',b'11000000'
	db	b'11000000',b'11000000'
	db	b'11000000',b'11000000'
	db	b'00000000',b'00000000'
				; G
	db	b'00111100',b'01111110'
	db	b'11000011',b'11000000'
	db	b'11000000',b'11000000'
	db	b'11001111',b'11001111'
	db	b'11000011',b'11000011'
	db	b'01111111',b'00111110'
	db	b'00000000',b'00000000'
				; H
	db	b'11000011',b'11000011'
	db	b'11000011',b'11000011'
	db	b'11000011',b'11111111'
	db	b'11111111',b'11000011'
	db	b'11000011',b'11000011'
	db	b'11000011',b'11000011'
	db	b'00000000',b'00000000'
				; I
	db	b'00111100',b'00111100'
	db	b'00011000',b'00011000'
	db	b'00011000',b'00011000'
	db	b'00011000',b'00011000'
	db	b'00011000',b'00011000'
	db	b'00111100',b'00111100'
	db	b'00000000',b'00000000'
				; J
	db	b'00111110',b'00111110'
	db	b'00000110',b'00000110'
	db	b'00000110',b'00000110'
	db	b'00000110',b'00000110'
	db	b'00000110',b'11000110'
	db	b'01111100',b'00111000'
	db	b'00000000',b'00000000'
				; K
	db	b'11000011',b'11000110'
	db	b'11001100',b'11011000'
	db	b'11110000',b'11100000'
	db	b'11000000',b'11100000'
	db	b'11011000',b'11001100'
	db	b'11000110',b'11000011'
	db	b'00000000',b'00000000'
				; L
	db	b'11000000',b'11000000'
	db	b'11000000',b'11000000'
	db	b'11000000',b'11000000'
	db	b'11000000',b'11000000'
	db	b'11000000',b'11000000'
	db	b'11111111',b'11111111'
	db	b'00000000',b'00000000'
				; M
	db	b'10000001',b'11000011'
	db	b'11100111',b'11111111'
	db	b'11011011',b'11000011'
	db	b'11000011',b'11000011'
	db	b'11000011',b'11000011'
	db	b'11000011',b'11000011'
	db	b'00000000',b'00000000'
				; N
	db	b'11000011',b'11000011'
	db	b'11000011',b'11000011'
	db	b'11000011',b'11100011'
	db	b'11110011',b'11011011'
	db	b'11001111',b'11000111'
	db	b'11000011',b'11000001'
	db	b'00000000',b'00000000'
				; O
	db	b'00111100',b'01111110'
	db	b'11000011',b'11000011'
	db	b'11000011',b'11000011'
	db	b'11000011',b'11000011'
	db	b'11000011',b'11000011'
	db	b'01111110',b'00111100'
	db	b'00000000',b'00000000'
				; P
	db	b'11111100',b'11111110'
	db	b'11000011',b'11000011'
	db	b'11000011',b'11111110'
	db	b'11111100',b'11000000'
	db	b'11000000',b'11000000'
	db	b'11000000',b'11000000'
	db	b'00000000',b'00000000'
				; Q
	db	b'00111100',b'01111110'
	db	b'11000011',b'11000011'
	db	b'11000011',b'11000011'
	db	b'11000011',b'11000011'
	db	b'11011011',b'11001111'
	db	b'01111110',b'00111011'
	db	b'00000000',b'00000000'
				; R
	db	b'11111100',b'11111110'
	db	b'11000011',b'11000011'
	db	b'11000011',b'11111110'
	db	b'11111100',b'11110000'
	db	b'11011000',b'11001100'
	db	b'11000110',b'11000011'
	db	b'00000000',b'00000000'
				; S
	db	b'00111100',b'01111110'
	db	b'11000011',b'11000000'
	db	b'11000000',b'01111100'
	db	b'00111110',b'00000011'
	db	b'00000011',b'11000011'
	db	b'01111110',b'00111100'
	db	b'00000000',b'00000000'
				; T
	db	b'11111111',b'11111111'
	db	b'00011000',b'00011000'
	db	b'00011000',b'00011000'
	db	b'00011000',b'00011000'
	db	b'00011000',b'00011000'
	db	b'00011000',b'00011000'
	db	b'00000000',b'00000000'
				; U
	db	b'11000011',b'11000011'
	db	b'11000011',b'11000011'
	db	b'11000011',b'11000011'
	db	b'11000011',b'11000011'
	db	b'11000011',b'11000011'
	db	b'01111110',b'00111100'
	db	b'00000000',b'00000000'
				; V
	db	b'11000011',b'11000011'
	db	b'11000011',b'11000011'
	db	b'11000011',b'11000011'
	db	b'01100110',b'01100110'
	db	b'00111100',b'00111100'
	db	b'00011000',b'00011000'
	db	b'00000000',b'00000000'
				; W
	db	b'11000011',b'11000011'
	db	b'11000011',b'11000011'
	db	b'11000011',b'11000011'
	db	b'11000011',b'11011011'
	db	b'11111111',b'11100111'
	db	b'11000011',b'10000001'
	db	b'00000000',b'00000000'
				; X
	db	b'11000011',b'11000011'
	db	b'11000011',b'01100110'
	db	b'00111100',b'00011000'
	db	b'00011000',b'00111100'
	db	b'01100110',b'11000011'
	db	b'11000011',b'11000011'
	db	b'00000000',b'00000000'
				; Y
	db	b'11000011',b'11000011'
	db	b'11000011',b'11000011'
	db	b'01100110',b'00111100'
	db	b'00011000',b'00011000'
	db	b'00011000',b'00011000'
	db	b'00011000',b'00011000'
	db	b'00000000',b'00000000'
				; Z
	db	b'11111111',b'11111111'
	db	b'00000011',b'00000110'
	db	b'00001100',b'00011000'
	db	b'00110000',b'01100000'
	db	b'11000000',b'11000000'
	db	b'11111111',b'11111111'
	db	b'00000000',b'00000000'
				; [
	db	b'00111100',b'00111100'
	db	b'00110000',b'00110000'
	db	b'00110000',b'00110000'
	db	b'00110000',b'00110000'
	db	b'00110000',b'00110000'
	db	b'00111100',b'00111100'
	db	b'00000000',b'00000000'
				; \
	db	b'00000000',b'00000000'
	db	b'10000000',b'11000000'
	db	b'01100000',b'00110000'
	db	b'00011000',b'00001100'
	db	b'00000110',b'00000011'
	db	b'00000001',b'00000000'
	db	b'00000000',b'00000000'
				; ]
	db	b'00111100',b'00111100'
	db	b'00001100',b'00001100'
	db	b'00001100',b'00001100'
	db	b'00001100',b'00001100'
	db	b'00001100',b'00001100'
	db	b'00111100',b'00111100'
	db	b'00000000',b'00000000'
				; ^
	db	b'00011000',b'00111100'
	db	b'01100110',b'00000000'
	db	b'00000000',b'00000000'
	db	b'00000000',b'00000000'
	db	b'00000000',b'00000000'
	db	b'00000000',b'00000000'
	db	b'00000000',b'00000000'
				; _
	db	b'00000000',b'00000000'
	db	b'00000000',b'00000000'
	db	b'00000000',b'00000000'
	db	b'00000000',b'00000000'
	db	b'00000000',b'00000000'
	db	b'00000000',b'11111111'
	db	b'11111111',b'00000000'

				; `
	db	b'00000000',b'00000000'
	db	b'00000000',b'00000000'
	db	b'00000000',b'00000000'
	db	b'00000000',b'00000000'
	db	b'00000000',b'00000000'
	db	b'00000000',b'00000000'
	db	b'00000000',b'00000000'
				; a
	db	b'00000000',b'00000000'
	db	b'00000000',b'01111100'
	db	b'01111110',b'00000011'
	db	b'00111111',b'01111111'
	db	b'11000011',b'11000011'
	db	b'01111111',b'00111111'
	db	b'00000000',b'00000000'
				; b
	db	b'11000000',b'11000000'
	db	b'11000000',b'11000000'
	db	b'11111100',b'11111110'
	db	b'11000011',b'11000011'
	db	b'11000011',b'11000011'
	db	b'11111110',b'11111100'
	db	b'00000000',b'00000000'
				; c
	db	b'00000000',b'00000000'
	db	b'00000000',b'00111111'
	db	b'01111111',b'11000000'
	db	b'11000000',b'11000000'
	db	b'11000000',b'11000000'
	db	b'01111111',b'00111111'
	db	b'00000000',b'00000000'
				; d
	db	b'00000011',b'00000011'
	db	b'00000011',b'00000011'
	db	b'00111111',b'01111111'
	db	b'11000011',b'11000011'
	db	b'11000011',b'11000011'
	db	b'01111111',b'00111111'
	db	b'00000000',b'00000000'
				; e
	db	b'00000000',b'00000000'
	db	b'00000000',b'00111100'
	db	b'01111110',b'11000011'
	db	b'11000011',b'11111111'
	db	b'11111111',b'11000000'
	db	b'01111110',b'00111110'
	db	b'00000000',b'00000000'
				; f
	db	b'00011100',b'00111110'
	db	b'01100011',b'01100000'
	db	b'01100000',b'11111000'
	db	b'11111000',b'01100000'
	db	b'01100000',b'01100000'
	db	b'01100000',b'01100000'
	db	b'00000000',b'00000000'
				; g
	db	b'00000000',b'00000000'
	db	b'00000000',b'00111100'
	db	b'01111110',b'11000011'
	db	b'11000011',b'11000011'
	db	b'01111111',b'00111111'
	db	b'00000011',b'00000011'
	db	b'01111110',b'01111100'
				; h
	db	b'11000000',b'11000000'
	db	b'11000000',b'11000000'
	db	b'11111100',b'11111110'
	db	b'11000011',b'11000011'
	db	b'11000011',b'11000011'
	db	b'11000011',b'11000011'
	db	b'00000000',b'00000000'
				; i
	db	b'00011000',b'00011000'
	db	b'00000000',b'00111000'
	db	b'00111000',b'00011000'
	db	b'00011000',b'00011000'
	db	b'00011000',b'00011000'
	db	b'00111100',b'00111100'
	db	b'00000000',b'00000000'
				; j
	db	b'00001100',b'00001100'
	db	b'00000000',b'00001100'
	db	b'00001100',b'00001100'
	db	b'00001100',b'00001100'
	db	b'00001100',b'00001100'
	db	b'00001100',b'11001100'
	db	b'01111000',b'00110000'
				; k
	db	b'11000000',b'11000000'
	db	b'11000000',b'11000011'
	db	b'11000110',b'11001100'
	db	b'11011000',b'11110000'
	db	b'11011000',b'11001100'
	db	b'11000110',b'11000011'
	db	b'00000000',b'00000000'
				; l
	db	b'00111000',b'00011000'
	db	b'00011000',b'00011000'
	db	b'00011000',b'00011000'
	db	b'00011000',b'00011000'
	db	b'00011000',b'00011000'
	db	b'00111100',b'00111100'
	db	b'00000000',b'00000000'
				; m
	db	b'00000000',b'00000000'
	db	b'00000000',b'10110110'
	db	b'11111111',b'11011011'
	db	b'11011011',b'11011011'
	db	b'11011011',b'11011011'
	db	b'11011011',b'11011011'
	db	b'00000000',b'00000000'
				; n
	db	b'00000000',b'00000000'
	db	b'00000000',b'11011100'
	db	b'11111110',b'11100011'
	db	b'11000011',b'11000011'
	db	b'11000011',b'11000011'
	db	b'11000011',b'11000011'
	db	b'00000000',b'00000000'
				; o
	db	b'00000000',b'00000000'
	db	b'00000000',b'00111100'
	db	b'01111110',b'11000011'
	db	b'11000011',b'11000011'
	db	b'11000011',b'11000011'
	db	b'01111110',b'00111100'
	db	b'00000000',b'00000000'
				; p
	db	b'00000000',b'00000000'
	db	b'00000000',b'11111100'
	db	b'11111110',b'11000011'
	db	b'11000011',b'11000011'
	db	b'11111110',b'11111100'
	db	b'11000000',b'11000000'
	db	b'11000000',b'11000000'
				; q
	db	b'00000000',b'00000000'
	db	b'00000000',b'00111111'
	db	b'01111111',b'11000011'
	db	b'11000011',b'11000011'
	db	b'01111111',b'00111111'
	db	b'00000011',b'00000011'
	db	b'00000011',b'00000011'
				; r
	db	b'00000000',b'00000000'
	db	b'00000000',b'11011111'
	db	b'11111111',b'11100000'
	db	b'11000000',b'11000000'
	db	b'11000000',b'11000000'
	db	b'11000000',b'11000000'
	db	b'00000000',b'00000000'
				; s
	db	b'00000000',b'00000000'
	db	b'00000000',b'00111111'
	db	b'01111111',b'11000000'
	db	b'01111100',b'00111110'
	db	b'00000011',b'00000011'
	db	b'11111110',b'11111100'
	db	b'00000000',b'00000000'
				; t
	db	b'01100000',b'01100000'
	db	b'01100000',b'11111000'
	db	b'11111000',b'01100000'
	db	b'01100000',b'01100000'
	db	b'01100000',b'01100011'
	db	b'00111110',b'00011100'
	db	b'00000000',b'00000000'
				; u
	db	b'00000000',b'00000000'
	db	b'00000000',b'11000011'
	db	b'11000011',b'11000011'
	db	b'11000011',b'11000011'
	db	b'11000011',b'11000011'
	db	b'01111111',b'00111111'
	db	b'00000000',b'00000000'
				; v
	db	b'00000000',b'00000000'
	db	b'00000000',b'11000011'
	db	b'11000011',b'11000011'
	db	b'11000011',b'11000011'
	db	b'11000011',b'01100110'
	db	b'00111100',b'00011000'
	db	b'00000000',b'00000000'
				; w
	db	b'00000000',b'00000000'
	db	b'00000000',b'11000011'
	db	b'11000011',b'11000011'
	db	b'11000011',b'11011011'
	db	b'11111111',b'11100111'
	db	b'11000011',b'10000001'
	db	b'00000000',b'00000000'
				; x
	db	b'00000000',b'00000000'
	db	b'00000000',b'11000011'
	db	b'01100110',b'00111100'
	db	b'00011000',b'00011000'
	db	b'00111100',b'01100110'
	db	b'11000011',b'11000011'
	db	b'00000000',b'00000000'
				; y
	db	b'00000000',b'00000000'
	db	b'00000000',b'11000011'
	db	b'11000011',b'11000011'
	db	b'11000011',b'11000011'
	db	b'01111111',b'00111111'
	db	b'00000011',b'00000011'
	db	b'01111110',b'01111100'
				; z
	db	b'00000000',b'00000000'
	db	b'00000000',b'11111111'
	db	b'11111111',b'00000110'
	db	b'00001100',b'00011000'
	db	b'00110000',b'01100000'
	db	b'11111111',b'11111111'
	db	b'00000000',b'00000000'
				; {
	db	b'00001110',b'00011110'
	db	b'00110000',b'00110000'
	db	b'00110000',b'01100000'
	db	b'01100000',b'00110000'
	db	b'00110000',b'00110000'
	db	b'00011110',b'00001110'
	db	b'00000000',b'00000000'
				; |
	db	b'00011000',b'00011000'
	db	b'00011000',b'00011000'
	db	b'00011000',b'00011000'
	db	b'00011000',b'00011000'
	db	b'00011000',b'00011000'
	db	b'00011000',b'00011000'
	db	b'00000000',b'00000000'
				; }
	db	b'01110000',b'01111000'
	db	b'00001100',b'00001100'
	db	b'00001100',b'00000110'
	db	b'00000110',b'00001100'
	db	b'00001100',b'00001100'
	db	b'01111000',b'01110000'
	db	b'00000000',b'00000000'
				; ~
	db	b'01110000',b'11011011'
	db	b'00001110',b'00000000'
	db	b'00000000',b'00000000'
	db	b'00000000',b'00000000'
	db	b'00000000',b'00000000'
	db	b'00000000',b'00000000'
	db	b'00000000',b'00000000'
				; 
	db	b'11111111',b'11111111'
	db	b'11000011',b'11000011'
	db	b'11000011',b'11000011'
	db	b'11000011',b'11000011'
	db	b'11000011',b'11000011'
	db	b'11111111',b'11111111'
	db	b'00000000',b'00000000'

;																						
;																						
;																						

charg4	; 5x3
						; 0
	db	b'1110',b'1010'
	db	b'1010',b'1010'
	db	b'1110'
				; 1
	db	b'1100',b'0100'
	db	b'0100',b'0100'
	db	b'1110'
				; 2
	db	b'1110',b'0010'
	db	b'1110',b'1000'
	db	b'1110'
				; 3
	db	b'1110',b'0010'
	db	b'1110',b'0010'
	db	b'1110'
				; 4
	db	b'1010',b'1010'
	db	b'1110',b'0010'
	db	b'0010'
				; 5
	db	b'1110',b'1000'
	db	b'1110',b'0010'
	db	b'1110'
				; 6
	db	b'1110',b'1000'
	db	b'1110',b'1010'
	db	b'1110'
				; 7
	db	b'1110',b'0010'
	db	b'0100',b'1000'
	db	b'1000'
				; 8
	db	b'1110',b'1010'
	db	b'1110',b'1010'
	db	b'1110'
				; 9
	db	b'1110',b'1010'
	db	b'1110',b'0010'
	db	b'1110'
				; blank
	db	b'0000',b'0000'
	db	b'0000',b'0000'
	db	b'0000'
